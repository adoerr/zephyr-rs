## CMakeLists.txt
```
# SPDX-License-Identifier: Apache-2.0

cmake_minimum_required(VERSION 3.20.0)

get_filename_component(ZEPHYR_RUST ${CMAKE_CURRENT_SOURCE_DIR}/../.. ABSOLUTE)

list(APPEND EXTRA_ZEPHYR_MODULES ${ZEPHYR_RUST})

message(STATUS "Zephyr Rust module: ${ZEPHYR_RUST}")

find_package(Zephyr)

project(hello_world)

target_sources(app PRIVATE ./src/main.c)
```

## prj.conf
```kconfig
CONFIG_RUST=y
CONFIG_RUST_APP_NAME="hello_world"
CONFIG_LOG=y
CONFIG_QEMU_ICOUNT=n
```

## src/main.c
```c
/*
 * Copyright (c) 2012-2014 Wind River Systems, Inc.
 *
 * SPDX-License-Identifier: Apache-2.0
 */

#include <zephyr/kernel.h>


/* External declaration for main in Rust. */
void rust_main(void);

int main(void)
{
	printk("Starting app\n");
	rust_main();
	printk("Done with app\n");
}
```
