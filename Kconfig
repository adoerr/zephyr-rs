## Kconfig
```kconfig
menuconfig RUST
	bool "Rust"
	select THREAD_CUSTOM_DATA
	help
	  Rust language support.

if RUST

    config RUST_ALLOC_KMALLOC
	bool "k_malloc"
	help
	  Adjust the pool size with CONFIG_HEAP_MEM_POOL_SIZE. Must be non-zero.

	config RUST_APP_NAME
	string "Rust application name"
    help
      Name of the Rust application.

    config RUST_APP_MANIFEST_DIR
    string "Rust application manifest directory"
    help
      Directory where the Rust application manifest is located.
      
endif
```
